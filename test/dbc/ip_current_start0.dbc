VERSION ""

NS_ :

BS_:

BU_: Vector__XXX

BO_ 962 IP_x02: 8 Vector__XXX
 SG_ IP_CURRENT : 0|32@1+ (1,-2147483648) [-1050000|1050000] "mA" Vector__XXX
