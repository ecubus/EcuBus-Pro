VERSION ""

NS_ :

BS_:

BU_: IG_Node

BO_ 512 Message_200: 8 Vector__XXX
 SG_ LwBmIO : 0|1@0+ (1,0) [0|1] "" Vector__XXX
 SG_ HhBmIO : 7|1@0+ (1,0) [0|1] "" Vector__XXX

BO_ 12 ID00CUI_status: 8 Vector__XXX
 SG_ UI_audioActive : 1|1@1+ (1,0) [0|1] ""  Vector__XXX
 SG_ UI_autopilotTrial : 12|2@1+ (1,0) [0|3] ""  Vector__XXX
 SG_ UI_bluetoothActive : 2|1@1+ (1,0) [0|1] ""  Vector__XXX
 SG_ UI_cameraActive : 41|1@1+ (1,0) [0|1] ""  Vector__XXX
 SG_ UI_cellActive : 3|1@1+ (1,0) [0|1] ""  Vector__XXX
 SG_ UI_cellConnected : 10|1@1+ (1,0) [0|1] ""  Vector__XXX
 SG_ UI_cellNetworkTechnology : 19|4@1+ (1,0) [0|15] ""  Vector__XXX
 SG_ UI_cellVector__XXXPower : 24|8@1+ (1,-128) [-128|127] "dB"  Vector__XXX
 SG_ UI_cellSignalBars : 42|3@1+ (1,0) [0|7] ""  Vector__XXX
 SG_ UI_cpuTemperature : 56|8@1- (1,40) [-20|100] "C"  Vector__XXX
 SG_ UI_developmentCar : 40|1@1+ (1,0) [0|1] ""  Vector__XXX
 SG_ UI_displayOn : 5|1@1+ (1,0) [0|1] ""  Vector__XXX
 SG_ UI_displayReady : 4|1@1+ (1,0) [0|1] ""  Vector__XXX
 SG_ UI_factoryReset : 14|2@1+ (1,0) [0|3] ""  Vector__XXX
 SG_ UI_falseTouchCounter : 32|8@1+ (1,0) [0|255] "1"  Vector__XXX
 SG_ UI_gpsActive : 16|1@1+ (1,0) [0|1] ""  Vector__XXX
 SG_ UI_pcbTemperature : 48|8@1- (1,40) [-20|100] "C"  Vector__XXX
 SG_ UI_radioActive : 18|1@1+ (1,0) [0|1] ""  Vector__XXX
 SG_ UI_readyForDrive : 9|1@1+ (1,0) [0|1] ""  Vector__XXX
 SG_ UI_screenshotActive : 17|1@1+ (1,0) [0|1] ""  Vector__XXX
 SG_ UI_systemActive : 8|1@1+ (1,0) [0|1] ""  Vector__XXX
 SG_ UI_touchActive : 0|1@1+ (1,0) [0|1] ""  Vector__XXX
 SG_ UI_vpnActive : 11|1@1+ (1,0) [0|1] ""  Vector__XXX
 SG_ UI_wifiActive : 6|1@1+ (1,0) [0|1] ""  Vector__XXX
 SG_ UI_wifiConnected : 7|1@1+ (1,0) [0|1] ""  Vector__XXX

BA_DEF_  "BusType" STRING ;
BA_DEF_DEF_  "BusType" "CAN";
